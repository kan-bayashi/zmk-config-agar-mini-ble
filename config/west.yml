## config/west.yml
```yaml
manifest:
  remotes:
    - name: zmkfirmware
      url-base: https://github.com/zmkfirmware
    - name: yangdigi
      url-base: https://github.com/yangdigi
  projects:
    - name: zmk
      remote: yangdigi
      revision: main
      import: app/west.yml
    - name: zmk-keyboards-klink
      remote: yangdigi
      revision: main
  self:
    path: config
```
